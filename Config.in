## Config.in
```kconfig
source "$BR2_EXTERNAL_LICHERVNANO_PATH/package/aic8800-sdio-driver/Config.in"
source "$BR2_EXTERNAL_LICHERVNANO_PATH/package/aic8800-sdio-firmware/Config.in"
```

## configs/licheerv_nano_we_defconfig
```kconfig
# Target toolchain
BR2_riscv=y
BR2_RISCV_64=y
BR2_TOOLCHAIN_BUILDROOT_MUSL=y
BR2_TOOLCHAIN_HEADERS_CUSTOM=n
BR2_KERNEL_HEADERS_AS_KERNEL=y
BR2_PACKAGE_HOST_LINUX_HEADERS_CUSTOM_6_19=y

# Linux kernel

# Root filesystem
BR2_ROOTFS_DEVICE_CREATION_DYNAMIC_DEVTMPFS=y
BR2_ROOTFS_DEVICE_TABLE="system/device_table.txt system/device_table_dev.txt"
BR2_ROOTFS_MERGED_USR=y
BR2_TARGET_ROOTFS_EXT2=y
BR2_TARGET_ROOTFS_EXT2_4=y
BR2_GLOBAL_PATCH_DIR="$(BR2_EXTERNAL_LICHERVNANO_PATH)/board/licheervnano/patches"
BR2_ROOTFS_OVERLAY="$(BR2_EXTERNAL_LICHERVNANO_PATH)/board/licheervnano/rootfs_overlay"
BR2_ROOTFS_POST_BUILD_SCRIPT="$(BR2_EXTERNAL_LICHERVNANO_PATH)/board/licheervnano/post-build.sh"
BR2_ROOTFS_POST_IMAGE_SCRIPT="$(BR2_EXTERNAL_LICHERVNANO_PATH)/board/licheervnano/post-image.sh"

# U-Boot
BR2_TARGET_UBOOT=y
BR2_TARGET_UBOOT_BUILD_SYSTEM_KCONFIG=y
BR2_TARGET_UBOOT_BOARD_DEFCONFIG="sipeed_licheerv_nano"
# use upstream uboot
BR2_TARGET_UBOOT_CUSTOM_GIT=y
BR2_TARGET_UBOOT_CUSTOM_REPO_URL="https://github.com/u-boot/u-boot.git"
BR2_TARGET_UBOOT_CUSTOM_REPO_VERSION="v2025.04"
BR2_TARGET_UBOOT_CONFIG_FRAGMENT_FILES="$(BR2_EXTERNAL_LICHERVNANO_PATH)/board/licheervnano/uboot.fragment"

# opensbi - prebuilt binary from Sipeed (in fiptool/data/opensbi.bin)
# Mainline OpenSBI does not yet support the SG2002 SoC.


# Linux kernel
BR2_LINUX_KERNEL=y
BR2_LINUX_KERNEL_CUSTOM_GIT=y
BR2_LINUX_KERNEL_CUSTOM_REPO_URL="https://github.com/torvalds/linux.git"
BR2_LINUX_KERNEL_CUSTOM_REPO_VERSION="v6.19"

BR2_LINUX_KERNEL_USE_CUSTOM_CONFIG=y
BR2_LINUX_KERNEL_CUSTOM_CONFIG_FILE="$(BR2_EXTERNAL_LICHERVNANO_PATH)/board/licheervnano/linux.config"

BR2_LINUX_KERNEL_IMAGE=y
BR2_LINUX_KERNEL_DTS_SUPPORT=y
BR2_LINUX_KERNEL_INTREE_DTS_NAME="sophgo/sg2002-licheerv-nano-b sophgo/sg2002-licheerv-nano-we"

BR2_PACKAGE_AIC8800_SDIO_DRIVER=y
BR2_PACKAGE_AIC8800_SDIO_FIRMWARE=y
BR2_PACKAGE_WPA_SUPPLICANT=y
BR2_PACKAGE_WPA_SUPPLICANT_WEXT=y
BR2_PACKAGE_WPA_SUPPLICANT_NL80211=y

BR2_PACKAGE_BLUEZ5_UTILS=y
BR2_PACKAGE_BLUEZ5_UTILS_CLIENT=y
BR2_PACKAGE_BLUEZ5_UTILS_TOOLS=y

BR2_PACKAGE_LIBGPIOD=y
BR2_PACKAGE_LIBGPIOD_TOOLS=y

BR2_PACKAGE_DROPBEAR=y
BR2_PACKAGE_GESFTPSERVER=y

BR2_PACKAGE_LIBCURL=y
BR2_PACKAGE_LIBCURL_CURL=y

BR2_PACKAGE_HOST_GENIMAGE=y
```

## package/aic8800-sdio-driver/Config.in
```kconfig
config BR2_PACKAGE_AIC8800_SDIO_DRIVER
	bool "aic8800-sdio-driver"
	depends on BR2_LINUX_KERNEL
	help
	  Out-of-tree kernel driver for the AIC8800 SDIO WiFi chip.
```

## package/aic8800-sdio-firmware/Config.in
```kconfig
config BR2_PACKAGE_AIC8800_SDIO_FIRMWARE
	bool "aic8800-sdio-firmware"
	help
	  Firmware files for the AIC8800 SDIO WiFi chip.
```
